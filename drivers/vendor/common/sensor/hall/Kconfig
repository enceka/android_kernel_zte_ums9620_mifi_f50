## drivers/vendor/common/sensor/hall/Kconfig
```kconfig
config HALL_SENSOR_AH1898
	tristate "HALL_SENSOR_AH1898"
		default n
		help
			Say Y here to build support for sensor hub new.
			To compile this driver as a module, choose M here.
```

## drivers/vendor/common/sqc_v8/Kconfig
```kconfig
# SPDX-License-Identifier: GPL-2.0-only
config VENDOR_SQC_MODULE
	tristate "sqc power policy"
	help
	  Say Y here, if supported zte sqc charger

config VENDOR_SQC_CHARGER_V8
	bool "sqc power v8"
	default n
	help
	  Say Y here, if supported zte sqc charger v8

config VENDOR_SQC_NETLINK
	tristate "sqc power NETLINK"
	help
	  Say Y here, if supported zte sqc charger NETLINK

config VENDOR_SQC_BQ2560X
	tristate "sqc power bq2560x"
	help
	  Say Y here, if supported zte sqc charger BQ2560X

config VENDOR_SQC_BQ2597X
	tristate "sqc power bq2597x"
	help
	  Say Y here, if supported zte sqc charger bq2597x

config VENDOR_SQC_SC8989X
	tristate "sqc power sc8989x"
	default n
	help
	  Say Y here, if supported zte sqc charger sc8989x

config VENDOR_SQC_SGM41510
	tristate "sqc power sgm41510"
	default n
	help
	  Say Y here, if supported zte sqc charger sgm41510

config VENDOR_SQC_HL7009
	tristate "sqc power hl7009"
	default n
	help
	  Say Y here, if supported zte sqc charger hl7009

config VENDOR_SQC_NU2115
        tristate "NU2115 Charger Pump driver"
        help
          If you say yes here you will get support for the NU2115 Charge Pump.
          This driver can give support for NU2115 Interface.

config VENDOR_SQC_SC8541
        tristate "SC8541 Charger Pump driver"
        help
          If you say yes here you will get support for the SC8541 Charge Pump.
          This driver can give support for SC8541 Interface.

config VENDOR_SQC_UPM6720
        tristate "UPM6720 Charger Pump driver"
        help
          If you say yes here you will get support for the UPM6720 Charge Pump.
          This driver can give support for UPM6720 Interface.

config VENDOR_SQC_SD76930
	tristate "sqc power sd76930"
	default n
	help
	  Say Y here, if supported zte sqc charger sd76930
```

## drivers/vendor/common/touchscreen_v2/axs_touch/Kconfig
```kconfig
#
# AXS Touchscreen driver configuration
#

config TOUCHSCREEN_AXS
    bool "AXS Touchscreen"
    default n
    help
      Say Y here if you have AXS touch panel.
      If unsure, say N.


    
```

## drivers/vendor/common/touchscreen_v2/chipone_tddi_pad/Kconfig
```kconfig
config TOUCHSCREEN_CHIPONE_PAD
	tristate "Chipone TDDI touchscreen for 9951Re"
	default n
	help
	  Say y here if you have chipone TDDI 9951R touch panel.
	  If unsure, say N.
```

## drivers/vendor/common/zte_pv_pintest/Kconfig
```kconfig
config ZTE_PV_PIN_TEST
	tristate "ZTE PIN GPIO Test support"
	help
		This option enable support for ZTE PV VERSION Test and interface.
```

## drivers/vendor/soc/sprd/Kconfig
```kconfig
#
# Kconfig for the sprd kernel device drivers.
#

config ZTE_BOOTREASON
	tristate "Zte Bootreason"
	default n
	help
	  Say Y here, support zte bootreason.

config ZTE_BOARD_STATE
	tristate "Zte Bootreason"
	default y
	help
	  Say Y here, support zte bootreason.

config ZTE_BEILU_GPIO_CTL
	tristate "Zte Beilu Gpio Control"
	default n
	help
	  Say Y here, support Beilu Gpio Control.

config ZTE_BEILU_GPIO_CTL_SRC
	tristate "Zte Beilu Gpio Control src"
	default n
	help
	  Say Y here, support Beilu Gpio Control.

config ZTE_SERIAL_KEYBOARD_DOCK
	tristate "Zte Serial Keyboard Dock"
	depends on INPUT
	---help---
	  Say Y here if you want to enable dock keyboard.

config ZTE_HDBD_GPIO_CTL
	tristate "Zte HDBD GPS Gpio Control"
	default n
	help
	  Say Y here, support Beilu Gpio Control.

config ZTE_LDO_LEDS
	tristate "Zte Ldo Leds Control"
	default n
	help
	  Say Y here, support Zte Ldo Leds Control.
```
